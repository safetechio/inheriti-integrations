## apps/inheriti-workspace/guest/Config.in
```kconfig
source "$BR2_EXTERNAL_INHERITI_WORKSPACE_PATH/package/workspace-agent/Config.in"
```

## apps/inheriti-workspace/guest/configs/workspace_x86_64_defconfig
```kconfig
BR2_x86_64=y
BR2_TOOLCHAIN_BUILDROOT_CXX=y
BR2_ROOTFS_DEVICE_CREATION_DYNAMIC_EUDEV=y
BR2_PACKAGE_HOST_LINUX_HEADERS_CUSTOM_6_18=y
BR2_LINUX_KERNEL=y
BR2_LINUX_KERNEL_CUSTOM_VERSION=y
BR2_LINUX_KERNEL_CUSTOM_VERSION_VALUE="6.18.7"
BR2_LINUX_KERNEL_USE_CUSTOM_CONFIG=y
BR2_LINUX_KERNEL_CUSTOM_CONFIG_FILE="board/qemu/x86_64/linux.config"
BR2_LINUX_KERNEL_CONFIG_FRAGMENT_FILES="$(BR2_EXTERNAL_INHERITI_WORKSPACE_PATH)/configs/no_sit_interface.fragment"
BR2_LINUX_KERNEL_NEEDS_HOST_LIBELF=y
BR2_PACKAGE_XORG7=y
BR2_PACKAGE_XSERVER_XORG_SERVER=y
BR2_PACKAGE_XSERVER_XORG_SERVER_MODULAR=y
BR2_PACKAGE_XDRIVER_XF86_INPUT_LIBINPUT=y
BR2_PACKAGE_WORKSPACE_AGENT=y
BR2_PACKAGE_DEJAVU=y
BR2_PACKAGE_DEJAVU_SANS=n
BR2_PACKAGE_DEJAVU_SERIF=n
BR2_PACKAGE_DEJAVU_SANS_CONDENSED=n
BR2_PACKAGE_DEJAVU_SERIF_CONDENSED=n
BR2_PACKAGE_MUPDF=y
BR2_PACKAGE_OPENSSL=y
BR2_PACKAGE_LIBOPENSSL_BIN=y
BR2_PACKAGE_BUSYBOX_SHOW_OTHERS=y
BR2_ROOTFS_OVERLAY="$(BR2_EXTERNAL_INHERITI_WORKSPACE_PATH)/overlay"
BR2_ROOTFS_POST_BUILD_SCRIPT="$(BR2_EXTERNAL_INHERITI_WORKSPACE_PATH)/post-build.sh"
BR2_TARGET_GENERIC_GETTY=n
BR2_TARGET_GENERIC_REMOUNT_ROOTFS_RW=n
BR2_TARGET_ROOTFS_CPIO=y
BR2_TARGET_ROOTFS_CPIO_GZIP=y
# BR2_TARGET_ROOTFS_TAR is not set
```

## apps/inheriti-workspace/guest/package/workspace-agent/Config.in
```kconfig
config BR2_PACKAGE_WORKSPACE_AGENT
	bool "Inheriti® Workspace guest agent"
	depends on BR2_USE_MMU
	select BR2_PACKAGE_FEH
	select BR2_PACKAGE_XTERM
	select BR2_PACKAGE_LESS
	select BR2_PACKAGE_LIBZIP
	select BR2_PACKAGE_LIBXML2
	depends on BR2_INSTALL_LIBSTDCPP && BR2_USE_WCHAR && BR2_TOOLCHAIN_HAS_THREADS && !BR2_STATIC_LIBS && BR2_TOOLCHAIN_GCC_AT_LEAST_7
	help
	  Open supported images, text, PDF and document files inside the
	  disposable virtual machine.
```

## apps/inheriti-workspace/scripts/optional-adapter/recipes/gnumeric/buildroot-external/package/Config.in
```kconfig
menu "Workspace optional Gnumeric application"
source "$BR2_EXTERNAL_WORKSPACE_GNUMERIC_PATH/package/workspace-libgsf/Config.in"
source "$BR2_EXTERNAL_WORKSPACE_GNUMERIC_PATH/package/workspace-goffice/Config.in"
source "$BR2_EXTERNAL_WORKSPACE_GNUMERIC_PATH/package/workspace-gnumeric/Config.in"
endmenu
```

## apps/inheriti-workspace/scripts/optional-adapter/recipes/gnumeric/buildroot-external/package/workspace-gnumeric/Config.in
```kconfig
config BR2_PACKAGE_WORKSPACE_GNUMERIC
	bool "Gnumeric XLSX/CSV viewer (optional application)"
	depends on BR2_PACKAGE_LIBGTK3_X11
	select BR2_PACKAGE_WORKSPACE_GOFFICE
	select BR2_PACKAGE_LIBFRIBIDI
```

## apps/inheriti-workspace/scripts/optional-adapter/recipes/gnumeric/buildroot-external/package/workspace-goffice/Config.in
```kconfig
config BR2_PACKAGE_WORKSPACE_GOFFICE
	bool "GOffice (optional application dependency)"
	depends on BR2_PACKAGE_LIBGTK3_X11
	select BR2_PACKAGE_WORKSPACE_LIBGSF
	select BR2_PACKAGE_LIBXSLT
	select BR2_PACKAGE_GDK_PIXBUF
	select BR2_PACKAGE_PANGO
	select BR2_PACKAGE_CAIRO
```

## apps/inheriti-workspace/scripts/optional-adapter/recipes/gnumeric/buildroot-external/package/workspace-libgsf/Config.in
```kconfig
config BR2_PACKAGE_WORKSPACE_LIBGSF
	bool "libGSF (optional application dependency)"
	depends on BR2_USE_MMU
	select BR2_PACKAGE_LIBGLIB2
	select BR2_PACKAGE_LIBXML2
```
